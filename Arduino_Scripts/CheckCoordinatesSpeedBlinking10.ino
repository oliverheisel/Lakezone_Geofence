#include <TinyGPS++.h>
#include <SoftwareSerial.h>
#include <LiquidCrystal_I2C.h>
#include <avr/pgmspace.h>

static const int RXPin = 4, TXPin = 3;
static const uint32_t GPSBaud = 9600;

TinyGPSPlus gps;
SoftwareSerial ss(RXPin, TXPin);
LiquidCrystal_I2C lcd(0x27, 16, 2);

int ROT = 8;
int GELB = 9;
int GRUN = 10;


const uint8_t polySides = 179;

// Grosses Polygon
const float polyY[polySides] PROGMEM = {47.35484441901, 47.35661938564, 47.35660047973, 47.35653836329, 47.35643361368, 47.3564259854, 47.35599040283, 47.35596591814, 47.35563905888, 47.35542166978, 47.35532448601, 47.35525983356, 47.3549749567,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 47.35442971511, 47.35484441901}; // X
const float polyX[polySides] PROGMEM = {8.5380774252, 8.546341109, 8.5464245294, 8.5465904664, 8.5466713003, 8.5466713347, 8.546904048, 8.5469247185, 8.5473114632, 8.5473960603, 8.5474248646, 8.5474599215, 8.5477079992,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 8.5379795811, 8.5380774252}; // Y

const uint8_t polySides2 = 65;

// kleines Polygon
const float polyY2[polySides2] PROGMEM = {47.35003957975, 47.35187943608, 47.35170584389, 47.35154557482, 47.35087503826, 47.35040657514, 47.35034403516, 47.35019731357, 47.35017450461, 47.35010598396, 47.34991474388, 47.34979983818, 47.34980149409,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 47.34991292196, 47.35003957975}; // X
const float polyX2[polySides2] PROGMEM = {8.5399408089, 8.5467977485, 8.5468962302, 8.5470294703, 8.5478175497, 8.5488755611, 8.5492242164, 8.5496769513, 8.5499578018, 8.5502616347, 8.5508429681, 8.5520744802, 8.5521919153,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 8.5400040658, 8.5399408089}; // Y

unsigned long previousMillis = 0; // will store last time LED was updated
const long interval = 500; // interval at which to blink (milliseconds)

void setup() {
  pinMode(ROT, OUTPUT);
  pinMode(GELB, OUTPUT);
  pinMode(GRUN, OUTPUT);

  Serial.begin(9600);
  ss.begin(GPSBaud);
  lcd.init();
  lcd.backlight();
}

void loop() {
  static bool ledState = LOW;
  unsigned long currentMillis = millis();
  
  if (ss.available() > 0) {
    if (gps.encode(ss.read())) {
        if (gps.location.isUpdated()) {
        bool inLargePolygon = pointInPolygon(gps.location.lng(), gps.location.lat(), polyX, polyY, polySides);
        bool inSmallPolygon = pointInPolygon(gps.location.lng(), gps.location.lat(), polyX2, polyY2, polySides2);
        double speedKmH = gps.speed.kmph();

        int ledPin = ROT; // Default to outside both polygons
        bool shouldBlink = speedKmH > 10;
        
        if (inSmallPolygon) {
          ledPin = GRUN;
          shouldBlink = speedKmH > 40;
        } else if (inLargePolygon) {
          ledPin = GELB;
        }

        if (shouldBlink && currentMillis - previousMillis >= interval) {
          previousMillis = currentMillis;
          if (ledState == LOW) {
            ledState = HIGH;
          } else {
            ledState = LOW;
          }
          digitalWrite(ROT, LOW);
          digitalWrite(GELB, LOW);
          digitalWrite(GRUN, LOW);
          digitalWrite(ledPin, ledState);
        } else if (!shouldBlink) {
          digitalWrite(ROT, LOW);
          digitalWrite(GELB, LOW);
          digitalWrite(GRUN, LOW);
          digitalWrite(ledPin, HIGH);
        }

        lcd.clear();
        lcd.setCursor(0, 0);
        lcd.print("Lat:");
        lcd.print(gps.location.lat(), 6);
        lcd.setCursor(0, 1);
        lcd.print("Lng:");
        lcd.print(gps.location.lng(), 6);

        // Reset previousMillis to currentMillis to manage LED blinking outside this block
        previousMillis = currentMillis;
        
      } 
    }
  } 
}

bool pointInPolygon(float x, float y, const float *polyX, const float *polyY, int polySides) {
  bool oddNodes = false;
  int j = polySides - 1;
  for (int i = 0; i < polySides; i++) {
    float xi = pgm_read_float_near(&polyX[i]);
    float yi = pgm_read_float_near(&polyY[i]);
    float xj = pgm_read_float_near(&polyX[j]);
    float yj = pgm_read_float_near(&polyY[j]);
    if ((yi < y && yj >= y) || (yj < y && yi >= y)) {
      oddNodes ^= (xi + (y - yi) / (yj - yi) * (xj - xi) < x);
    }
    j = i;
  }
  return oddNodes;
}