#include <TinyGPS++.h>
#include <SoftwareSerial.h>
#include <LiquidCrystal_I2C.h>
#include <avr/pgmspace.h>

static const int RXPin = 4, TXPin = 3;
static const uint32_t GPSBaud = 9600;

TinyGPSPlus gps;
SoftwareSerial ss(RXPin, TXPin);
LiquidCrystal_I2C lcd(0x27, 16, 2);

int ROT = 8;
int GELB = 9;
int GRUN = 10;


const uint8_t polySides = 179;

// Grosses Polygon
const float polyX[polySides] PROGMEM = {45.576489947, 90.323515135, 106.646121384, 126.432929667, 161.042399153, 165.814000805, 145.857243108, 135.01559567, 144.469731493, 161.113592326, 157.511264957, 145.240832261, 192.133132617,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 25.07965551, 45.576489947}; // X
const float polyY[polySides] PROGMEM = {8.538077425, 8.546341109, 8.546424529, 8.546590466, 8.5466713, 8.546671335, 8.546904048, 8.546924719, 8.547311463, 8.54739606, 8.547424865, 8.547459922, 8.547707999,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 8.537979581, 8.538077425}; // Y

const uint8_t polySides2 = 65;

// kleines Polygon
const float polyX2[polySides2] PROGMEM = {24.220585658, 112.706608929, 145.347266556, 135.327120134, 122.137712075, 107.025967725, 104.062831122, 101.299704246, 98.675904324, 105.459168153, 101.77003701, 92.261333756, 86.262376309,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 335.387683314, 24.220585658}; // X
const float polyY2[polySides2] PROGMEM = {8.539940809, 8.546797749, 8.54689623, 8.54702947, 8.54781755, 8.548875561, 8.549224216, 8.549676951, 8.549957802, 8.550261635, 8.550842968, 8.55207448, 8.552191915,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 8.540004066, 8.539940809}; // Y

unsigned long previousMillis = 0; // will store last time LED was updated
const long interval = 500; // interval at which to blink (milliseconds)

void setup() {
  pinMode(ROT, OUTPUT);
  pinMode(GELB, OUTPUT);
  pinMode(GRUN, OUTPUT);

  Serial.begin(9600);
  ss.begin(GPSBaud);
  lcd.init();
  lcd.backlight();
}

void loop() {
  static bool ledState = LOW;
  unsigned long currentMillis = millis();

  if (ss.available() > 0) {
    if (gps.encode(ss.read())) {
      if (gps.location.isUpdated()) {
        bool inLargePolygon = pointInPolygon(gps.location.lng(), gps.location.lat(), polyX, polyY, polySides);
        bool inSmallPolygon = pointInPolygon(gps.location.lng(), gps.location.lat(), polyX2, polyY2, polySides2);
        lcd.setCursor(0, 1);
        lcd.print("2");
        double speedKmH = gps.speed.kmph();

        int ledPin = ROT; // Default to outside both polygons
        bool shouldBlink = speedKmH > 10;
        
        if (inSmallPolygon) {
          ledPin = GRUN;
          shouldBlink = speedKmH > 40;
        } else if (inLargePolygon) {
          ledPin = GELB;
        }

        if (shouldBlink && currentMillis - previousMillis >= interval) {
          previousMillis = currentMillis;
          if (ledState == LOW) {
            ledState = HIGH;
          } else {
            ledState = LOW;
          }
          digitalWrite(ROT, LOW);
          digitalWrite(GELB, LOW);
          digitalWrite(GRUN, LOW);
          digitalWrite(ledPin, ledState);
        } else if (!shouldBlink) {
          digitalWrite(ROT, LOW);
          digitalWrite(GELB, LOW);
          digitalWrite(GRUN, LOW);
          digitalWrite(ledPin, HIGH);
        }

        lcd.clear();
        lcd.setCursor(0, 0);
        lcd.print("Lat:");
        lcd.print(gps.location.lat(), 6);
        lcd.setCursor(0, 1);
        lcd.print("Lng:");
        lcd.print(gps.location.lng(), 6);
      }
    }
  }
}

bool pointInPolygon(float x, float y, const float *polyX, const float *polyY, int polySides) {
  bool oddNodes = false;
  int j = polySides - 1;
  for (int i = 0; i < polySides; i++) {
    float xi = pgm_read_float_near(&polyX[i]);
    float yi = pgm_read_float_near(&polyY[i]);
    float xj = pgm_read_float_near(&polyX[j]);
    float yj = pgm_read_float_near(&polyY[j]);
    if ((yi < y && yj >= y) || (yj < y && yi >= y)) {
      oddNodes ^= (xi + (y - yi) / (yj - yi) * (xj - xi) < x);
    }
    j = i;
  }
  return oddNodes;
}